## config/west.yml
```yaml
manifest:
  remotes:
    - name: zmkfirmware
      url-base: https://github.com/zmkfirmware
    - name: mouse-ftc
      url-base: https://github.com/ftc
  projects:
    - name: zmk
      remote: mouse-ftc
      revision: mouse-ftc
      import: app/west.yml
  self:
    path: config
```
